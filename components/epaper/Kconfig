## components/epaper/Kconfig
```kconfig
menu "EPAPER Driver Configuration"

    choice
        prompt "EPaper Module Selection"
        default 7_5_INCH_BICOLOR_EPAPER_DRIVER

    config 7_5_INCH_BICOLOR_EPAPER_DRIVER
        bool "7.5 inch bicolor epaper"
        help 
            https://www.seeedstudio.com/7-5-Monochrome-ePaper-Display-with-800x480-Pixels-p-5788.html

    config 7_5_INCH_TRICOLOR_EPAPER_DRIVER
        bool "7.5 inch tricolor epaper"
        help 
            https://www.waveshare.com/product/displays/e-paper/epaper-1/7.5inch-e-paper-b.htm?___SID=U

    endchoice

endmenu
```
